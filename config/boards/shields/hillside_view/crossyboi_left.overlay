/*
 * Copyright (c) 2022 The ZMK Contributors
 *
 * SPDX-License-Identifier: MIT
 */

#include "crossyboi.dtsi"

&left_encoder {
    status = "okay";
	a-gpios = <&gpio0 31 (GPIO_ACTIVE_HIGH | GPIO_PULL_UP)>;
	b-gpios = <&gpio0 29 (GPIO_ACTIVE_HIGH | GPIO_PULL_UP)>;
};
/*
&chosen {
  zephyr,display = &nice_view;
};

// nice view bus
&nice_view_spi {
  status = "okay";
};

&nice_view {
  status = "okay";
};
*/
/ {
    /* define virtual input, will be resurrected for emitting input event */
	/* NOTE: set `device = <&glidepoint1>` in `zmk,input-listener` */
	glidepoint1: virtual_input {
		compatible = "zmk,virtual-input";
	};

	/* for central side, define (relay-channel)-to-(virtual-input) mapping */
	input_relay_config_102 {
		compatible = "zmk,split-peripheral-input-relay";
		
		/* channel id, used to filter incoming input event from split peripheral */
		/* NOTE: should matching relay-channel on peripheral overlay */
		relay-channel = <102>;

		/* virtual input device on central, which used to emit input event as an agent device */
		device = <&glidepoint1>;
	};
};

