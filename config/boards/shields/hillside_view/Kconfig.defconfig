## config/boards/shields/hillside_view/Kconfig.defconfig
```kconfig
# Copyright (c) 2022 The ZMK Contributors
# SPDX-License-Identifier: MIT

if SHIELD_CROSSYBOI

config ZMK_KEYBOARD_NAME
    default "Crossyboi"

config ZMK_SPLIT_ROLE_CENTRAL
    default y

config ZMK_USB
    default y

endif # SHIELD_CROSSYBOI_LEFT

if SHIELD_CROSSYBOI_LEFT || SHIELD_CROSSYBOI_RIGHT

config ZMK_SPLIT
    default y

if ZMK_MOUSE

config I2C
  default y

endif # ZMK_MOUSE

endif # SHIELD_CROSSYBOI_LEFT || SHIELD_CROSSYBOI_RIGHT
```

## config/boards/shields/hillside_view/Kconfig.shield
```kconfig
# Copyright (c) 2022 The ZMK Contributors
# SPDX-License-Identifier: MIT

config SHIELD_CROSSYBOI_LEFT
    def_bool $(shields_list_contains,crossyboi_left)

config SHIELD_CROSSYBOI_RIGHT
    def_bool $(shields_list_contains,crossyboi_right)
```
